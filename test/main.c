/******************************************************************************
 * @file    main.c
 * @brief   小车进阶动作测试：直行 -> 左转闪灯 -> 右转 -> 鸣笛 -> 倒车提示
 ******************************************************************************/

#define  _MAIN_C
#include "config.h"
#include "timer_ISR.h"
#include "motor.h"
#include "Delay.h"
#include "main.h"

/* ----------------------------------------------------------------------------
 * 按键扫描：等待 S2 按下并松手后鸣笛一声，作为程序启动信号
 * @note  阻塞式等待，按键按下前主循环不往下走（测试程序可接受）
 * -------------------------------------------------------------------------- */
void keyscan()
{
    for(;;)    /* 死循环等待按键 */
    {
        if(KEY_S2 == 0)          /* 实时检测 S2 是否被按下 */
        {
            Delay1ms(5);         /* 软件消抖 */
            if(KEY_S2 == 0)      /* 再检测一次确认 */
            {
                while(!KEY_S2);  /* 松手检测 */
                BUZZER_on;       /* 开启蜂鸣器 */
                Delay1ms(200);   /* 200ms 延时 */
                BUZZER_off;      /* 关闭蜂鸣器 */
                break;           /* 退出 for 死循环 */
            }
        }
    }
}

/* ----------------------------------------------------------------------------
 * 主函数：直行 -> 闪灯左转 -> 右转 -> 鸣笛 -> 倒车提示
 * -------------------------------------------------------------------------- */
void main()
{
    /* ★ Keil C89 不允许在 for 内定义变量，必须在块首声明；
     *   若换 C99 编译器(如 SDCC/GCC)可放宽此限制 ★ */
    unsigned char i;

    IntRegInit();   /* 中断寄存器初始化 */
    Timer0Init();   /* PWM 调速初始化 */

    SmartCarStops(); /* 初始先停车，防止失控 */
    keyscan();       /* 按 S2 按键启动 */

    // ---------- 1. 直行 ----------
    // 左轮速度 130，右轮速度 130（差速补偿，抵消两电机个体差异）
    SmartCarForward(130, 130);
    Delay1ms(2000); // 直行 2 秒

    // ---------- 2. 左转 + 闪灯 3 次（共约 1.2 秒） ----------
    // 左转：左轮停，右轮以 180 前进（单轮驱动，绕左轮画弧）
    // 注意：左转持续整个 1.2 秒闪灯过程，不是闪完才转
    SmartCarLeft(130);

    for(i = 0; i < 3; i++)
    {
        LED = 0; // 灯亮（假设低电平亮，若极性相反请把 0/1 互换）
        Delay1ms(200);
        LED = 1; // 灯灭
        Delay1ms(200);
    }

    // ---------- 3. 右转 ----------
    // 右转：右轮停，左轮以 180 前进（单轮驱动，绕右轮画弧）
    SmartCarRight(130);
    Delay1ms(1200); // 右转 1.2 秒

    // ---------- 4. 停车 + 鸣笛 ----------
    SmartCarStops(); // 先停车
    Delay1ms(200);   // 缓冲一下

    BUZZER_on;       // 鸣笛 1
    Delay1ms(300);
    BUZZER_off;
    Delay1ms(100);

    BUZZER_on;       // 鸣笛 2
    Delay1ms(300);
    BUZZER_off;

    Delay1ms(500);   // 停顿半秒

    // ---------- 5. 后退（每 0.5 秒"嘀"一声，像真车倒车提示） ----------
    // 两轮全速倒车
    SmartCarBack(80, 80);

    // 倒车 2 秒 = 4 个 0.5 秒周期；每周期：响 150ms + 停 350ms
    for(i = 0; i < 4; i++)
    {
        BUZZER_on;
        Delay1ms(150);   // 嘀 150ms
        BUZZER_off;
        Delay1ms(350);   // 静音 350ms
    }

    // ---------- 彻底停车 ----------
    SmartCarStops();

    while(1); // 停机死循环，程序停在这里
}