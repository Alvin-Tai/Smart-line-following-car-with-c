/******************************************************************************
 * @file    main.c
 * @brief   按键启动 + 蜂鸣器鸣笛 + 传感器触发计数 + 数码管/LED/停车死循环测试程序
 * @note    极性：压线 = 1，空白 = 0
 ******************************************************************************/

#include <reg52.h>
#include "config.h"
#include "motor.h"
#include "Delay.h"

/* 数码管段码表和锁存器定义 */
unsigned char code smg_code[] = {0x3F, 0x06, 0x5B, 0x4F, 0x66, 0x6D, 0x7D, 0x07, 0x7F, 0x6F};

sbit DU   = P2^6;  // 段选锁存器
sbit WE   = P2^7;  // 位选锁存器
sbit KEY  = P3^0;  // 按键 S2 定义
sbit BEEP = P2^3;  // 蜂鸣器定义

#define SPEED_TEST 70   /* 测试时的直行基础速度 */

void main()
{
    unsigned int trigger_loops = 0;  // 核心：统计传感器触发期间主循环跑了多少轮
    unsigned char i;
    unsigned char num[4] = {0};      // 拆解后的 4 位数字
    unsigned int temp;

    // 初始化时先确保电机停止、蜂鸣器关闭、LED点亮指示就绪
    SmartCarStops();
    BEEP = 1; // 假设高电平关闭蜂鸣器（若响声相反可调换）
    LED = 1;

    // ==========================================================
    // 阶段零：按键启动 + 短暂鸣笛提示
    // ==========================================================
    while (1)
    {
        if (KEY == 0)           // 检测按键按下（低电平有效）
        {
            Delay1ms(10);       // 简单消抖
            if (KEY == 0)
            {
                while (KEY == 0); // 等待按键松开
                
                /* --- 触发按键后：短暂鸣笛 200ms --- */
                BEEP = 0;       // 开启蜂鸣器（若不响可尝试改为 BEEP = 1）
                Delay1ms(200);  // 鸣笛持续 200 毫秒
                BEEP = 1;       // 关闭蜂鸣器
                
                break;          // 鸣笛结束，跳出等待，正式发车！
            }
        }
    }

    // ==========================================================
    // 阶段一与阶段二合并：直行寻靶并自动记录触发时长
    // ==========================================================
    
    // 1. 先直行等待，直到传感器“刚开始压线”（从 0 变成 1）
    while (TrackSensorLeft == 0 && TrackSensorRight == 0)
    {
        SmartCarForward(SPEED_TEST, SPEED_TEST);
        LED = 1; 
    }

    // 2. 已经压线！立刻开始一边直行、一边疯狂计数，直到传感器离开（变回 0）
    trigger_loops = 0;
    while (TrackSensorLeft == 1 || TrackSensorRight == 1)
    {
        SmartCarForward(SPEED_TEST, SPEED_TEST);
        trigger_loops++; // 主循环每跑一次，计数器+1
        LED = 0;         // 压线时 LED 点亮反馈
    }

    // ==========================================================
    // 阶段三：传感器停止触发后，继续直行一小段距离
    // ==========================================================
    SmartCarForward(SPEED_TEST, SPEED_TEST);
    Delay1ms(500); 

    // ==========================================================
    // 阶段四：数据处理准备
    // ==========================================================
    temp = trigger_loops;
    
    num[0] = temp / 1000 % 10;
    num[1] = temp / 100 % 10;
    num[2] = temp / 10 % 10;
    num[3] = temp % 10;

    // ==========================================================
    // 阶段五：常驻死循环（停车、LED、动态数码管）
    // ==========================================================
    while(1)
    {
        // 1. 持续调用电机急停函数，锁死电机
        SmartCarStops();

        // 2. LED 状态控制
        LED = 0; 

        // 3. 动态扫描数码管显示测得的循环轮数
        for(i = 0; i < 4; i++)
        {
            P0 = 0xFF; 
            WE = 1; WE = 0; 

            P0 = smg_code[num[i]]; 
            DU = 1; DU = 0; 

            P0 = ~(1 << i); 
            WE = 1; WE = 0; 

            Delay1ms(2);
        }
    }
}